/**
  *******************************************************************
  * Chip: LPC1769
  * NOTE: This file is generated by CoIDE and Included by *link.ld
  *       It is used to describe which memory regions may be used
  *       by the linker.
  *******************************************************************
  * Internal memory map
  *   Region      Start           Size
  *   flash0      0x00000000      0x00080000
  *   sram0       0x10000000      0x00008000
  *   sram1       0x2007C000      0x00008000
  *******************************************************************
*/

MEMORY
{
	rom (rx)  : ORIGIN = 0x00000000, LENGTH = 0x00080000
	ram (rwx) : ORIGIN = 0x10000000, LENGTH = 0x00008000
	ram1 (rwx) : ORIGIN = 0x2007C000, LENGTH = 0x00008000
}

_eram = 0x10000000 + 0x00008000;